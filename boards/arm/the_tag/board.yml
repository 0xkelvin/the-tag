## boards/arm/the_tag/board.yml
```yaml
board:
  name: the_tag
  full_name: The Tag
  vendor: custom
  socs:
    - name: nrf54l15
```

## firmware/boards/arm/the_tag/Kconfig.the_tag
```kconfig
# SPDX-License-Identifier: Apache-2.0

config BOARD_THE_TAG
	select SOC_NRF54L15_CPUAPP if BOARD_THE_TAG_NRF54L15_CPUAPP
```
