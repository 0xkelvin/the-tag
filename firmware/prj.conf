## sysbuild.conf
```
# Enable MCUboot
SB_CONFIG_BOOTLOADER_MCUBOOT=y
```

## prj.conf
```kconfig
CONFIG_SPI=y
CONFIG_DISPLAY=y
CONFIG_SSD16XX=n
CONFIG_LOG=y
CONFIG_BT=y
CONFIG_BT_PERIPHERAL=y
CONFIG_BT_BROADCASTER=y
CONFIG_BT_DEVICE_NAME="the-tag"
CONFIG_BT_SMP=y
CONFIG_BT_BONDABLE=y

CONFIG_SETTINGS=y
CONFIG_BT_SETTINGS=y

# BLE data throughput: negotiate larger MTU for faster image transfer
CONFIG_BT_L2CAP_TX_MTU=247
CONFIG_BT_BUF_ACL_RX_SIZE=251
CONFIG_BT_BUF_ACL_TX_SIZE=251
CONFIG_BT_CTLR_DATA_LENGTH_MAX=251

# GATT config
CONFIG_BT_GATT_CLIENT=y
CONFIG_BT_ATT_PREPARE_COUNT=2

# Required for manual driver
CONFIG_GPIO=y
CONFIG_HEAP_MEM_POOL_SIZE=8192
CONFIG_MCUBOOT_EXTRA_IMGTOOL_ARGS="--header-size 0x400"
```

## debug.conf
```kconfig
# Debug build configuration
```

## src/main.c
```c
/*
 * Copyright (c) 2024 Kelvin
 * SPDX-License-Identifier: Apache-2.0
 */

#include <zephyr/device.h>
#include <zephyr/drivers/spi.h>
#include <zephyr/drivers/gpio.h>
#include <zephyr/kernel.h>
#include <zephyr/logging/log.h>
#include <string.h>
#include <zephyr/bluetooth/bluetooth.h>
#include <zephyr/bluetooth/hci.h>

#include "ble_backend.h"
#include "ble_image_service.h"
#include "image_boaviet.h"

LOG_MODULE_REGISTER(main, CONFIG_LOG_DEFAULT_LEVEL);

#define EPD_WIDTH 152
#define EPD_HEIGHT 152
#define BUFFER_SIZE (EPD_WIDTH * EPD_HEIGHT / 4)

/* GPIO pins */
#define DC_NODE    DT_NODELABEL(gpio1)
#define RESET_NODE DT_NODELABEL(gpio1)
#define BUSY_NODE  DT_NODELABEL(gpio1)
#define CS_NODE    DT_NODELABEL(gpio1)

#define DC_PIN     7   // P1.07 (D3)
#define RESET_PIN  4   // P1.04 (D0)
#define BUSY_PIN   11  // P1.11 (D5)
#define CS_PIN     5   // P1.05 (D1)

/* LED */
#define LED0_NODE DT_ALIAS(led0)

static struct gpio_dt_spec dc_gpio;
static struct gpio_dt_spec reset_gpio;
static struct gpio_dt_spec busy_gpio;
static struct gpio_dt_spec cs_gpio;
static struct gpio_dt_spec led = GPIO_DT_SPEC_GET(LED0_NODE, gpios);

static const struct device *spi_dev;
static struct spi_config spi_cfg;

static uint8_t frame_buffer[BUFFER_SIZE];

static K_SEM_DEFINE(image_ready_sem, 0, 1);
static const uint8_t *pending_image_data;
static uint16_t pending_image_size;

static void on_ble_image_ready(const uint8_t *data, uint16_t size)
{
    pending_image_data = data;
    pending_image_size = size;
    k_sem_give(&image_ready_sem);
}

/* Helper functions */
static void jd79661_write_cmd(uint8_t cmd)
{
    struct spi_buf tx_buf = {.buf = &cmd, .len = 1};
    struct spi_buf_set tx_bufs = {.buffers = &tx_buf, .count = 1};
    
    gpio_pin_set_dt(&cs_gpio, 1);  // CS active (low)
    gpio_pin_set_dt(&dc_gpio, 0);  // Command mode
    spi_write(spi_dev, &spi_cfg, &tx_bufs);
    gpio_pin_set_dt(&cs_gpio, 0);  // CS inactive (high)
}

static void jd79661_write_data(uint8_t data)
{
    struct spi_buf tx_buf = {.buf = &data, .len = 1};
    struct spi_buf_set tx_bufs = {.buffers = &tx_buf, .count = 1};
    
    gpio_pin_set_dt(&cs_gpio, 1);  // CS active (low)
    gpio_pin_set_dt(&dc_gpio, 1);  // Data mode
    spi_write(spi_dev, &spi_cfg, &tx_bufs);
    gpio_pin_set_dt(&cs_gpio, 0);  // CS inactive (high)
}

static void jd79661_write_data_bulk(const uint8_t *data, size_t len)
{
    gpio_pin_set_dt(&cs_gpio, 1);  // CS active (low)
    gpio_pin_set_dt(&dc_gpio, 1);  // Data mode
    
    // Write in chunks
    const size_t chunk_size = 256;
    for (size_t i = 0; i < len; i += chunk_size) {
        size_t remaining = len - i;
        size_t write_len = (remaining < chunk_size) ? remaining : chunk_size;
        
        struct spi_buf tx_buf = {.buf = (void *)(data + i), .len = write_len};
        struct spi_buf_set tx_bufs = {.buffers = &tx_buf, .count = 1};
        spi_write(spi_dev, &spi_cfg, &tx_bufs);
    }
    
    gpio_pin_set_dt(&cs_gpio, 0);  // CS inactive (high)
}

static void jd79661_wait_busy(void)
{
    int cnt = 0;
    /* BUSY=0 means busy, BUSY=1 means idle */
    LOG_INF("Waiting for busy (initial: %d)...", gpio_pin_get_dt(&busy_gpio));
    while (gpio_pin_get_dt(&busy_gpio) == 0) {
        k_msleep(10);
        cnt++;
        if (cnt > 500) { // 5s timeout
            LOG_ERR("Busy timeout!");
            break;
        }
    }
    LOG_INF("Busy released");
}

static void jd79661_reset(void)
{
    k_msleep(20);
    gpio_pin_set_dt(&reset_gpio, 0);  // Reset low
    k_msleep(40);
    gpio_pin_set_dt(&reset_gpio, 1);  // Reset high
    k_msleep(50);
}

static int jd79661_init(void)
{
    LOG_INF("Initializing JD79661...");
    
    jd79661_reset();
    jd79661_wait_busy();
    
    // Initialization sequence from STM32 sample code
    jd79661_write_cmd(0x4D);
    jd79661_write_data(0x78);
    k_usleep(100);
    
    jd79661_write_cmd(0x00);  // PSR
    jd79661_write_data(0x0F);
    jd79661_write_data(0x29);
    k_usleep(100);
    
    jd79661_write_cmd(0x01);  // PWRR
    jd79661_write_data(0x07);
    jd79661_write_data(0x00);
    k_usleep(100);
    
    jd79661_write_cmd(0x03);  // POFS
    jd79661_write_data(0x10);
    jd79661_write_data(0x54);
    jd79661_write_data(0x44);
    k_usleep(100);
    
    jd79661_write_cmd(0x06);  // BTST_P
    jd79661_write_data(0x05);
    jd79661_write_data(0x00);
    jd79661_write_data(0x3F);
    jd79661_write_data(0x0A);
    jd79661_write_data(0x25);
    jd79661_write_data(0x12);
    jd79661_write_data(0x1A);
    k_usleep(100);
    
    jd79661_write_cmd(0x50);  // CDI
    jd79661_write_data(0x37);
    k_usleep(100);
    
    jd79661_write_cmd(0x60);  // TCON
    jd79661_write_data(0x02);
    jd79661_write_data(0x02);
    k_usleep(100);
    
    jd79661_write_cmd(0x61);  // TRES
    jd79661_write_data(EPD_WIDTH / 256);
    jd79661_write_data(EPD_WIDTH % 256);
    jd79661_write_data(EPD_HEIGHT / 256);
    jd79661_write_data(EPD_HEIGHT % 256);
    k_usleep(100);
    
    jd79661_write_cmd(0xE7);
    jd79661_write_data(0x1C);
    k_usleep(100);
    
    jd79661_write_cmd(0xE3);
    jd79661_write_data(0x22);
    k_usleep(100);
    
    jd79661_write_cmd(0xB4);
    jd79661_write_data(0xD0);
    k_usleep(100);
    
    jd79661_write_cmd(0xB5);
    jd79661_write_data(0x03);
    k_usleep(100);
    
    jd79661_write_cmd(0xE9);
    jd79661_write_data(0x01);
    k_usleep(100);
    
    jd79661_write_cmd(0x30);
    jd79661_write_data(0x08);
    k_usleep(100);
    
    jd79661_write_cmd(0x04);  // Power on
    jd79661_wait_busy();
    
    LOG_INF("JD79661 initialized");
    return 0;
}

static void jd79661_display_frame(const uint8_t *buffer, size_t size)
{
    LOG_INF("Sending framebuffer (%d bytes)...", size);
    
    jd79661_write_cmd(0x10);  // Write data
    jd79661_write_data_bulk(buffer, size);
    
    LOG_INF("Refreshing display...");
    jd79661_write_cmd(0x12);  // Display refresh
    jd79661_write_data(0x00);
    jd79661_wait_busy();
    
    LOG_INF("Display update complete");
}

int main(void)
{
    int ret;
    
    LOG_INF("=== The-Tag Firmware ===");
    
    ble_backend_init();
    ble_image_service_init(on_ble_image_ready);

    /* LED Init */
    if (!gpio_is_ready_dt(&led)) {
        LOG_ERR("LED GPIO not ready");
        return -ENODEV;
    }
    gpio_pin_configure_dt(&led, GPIO_OUTPUT_ACTIVE);
    
    /* SPI Init */
    spi_dev = DEVICE_DT_GET(DT_NODELABEL(spi00));
    if (!device_is_ready(spi_dev)) {
        LOG_ERR("SPI device not ready");
        return -ENODEV;
    }
    
    spi_cfg.frequency = 4000000;  // 4 MHz
    spi_cfg.operation = SPI_WORD_SET(8) | SPI_TRANSFER_MSB | SPI_OP_MODE_MASTER;
    spi_cfg.slave = 0;
    spi_cfg.cs = (struct spi_cs_control) {
        .gpio = {0},  // No auto CS
        .delay = 0,
    };
    
    /* GPIO Init */
    dc_gpio.port = DEVICE_DT_GET(DC_NODE);
    dc_gpio.pin = DC_PIN;
    dc_gpio.dt_flags = GPIO_ACTIVE_HIGH;
    
    reset_gpio.port = DEVICE_DT_GET(RESET_NODE);
    reset_gpio.pin = RESET_PIN;
    reset_gpio.dt_flags = GPIO_ACTIVE_HIGH;
    
    busy_gpio.port = DEVICE_DT_GET(BUSY_NODE);
    busy_gpio.pin = BUSY_PIN;
    busy_gpio.dt_flags = GPIO_ACTIVE_HIGH;
    
    cs_gpio.port = DEVICE_DT_GET(CS_NODE);
    cs_gpio.pin = CS_PIN;
    cs_gpio.dt_flags = GPIO_ACTIVE_LOW;
    
    if (!device_is_ready(dc_gpio.port)) {
        LOG_ERR("GPIO not ready");
        return -ENODEV;
    }
    
    ret = gpio_pin_configure_dt(&dc_gpio, GPIO_OUTPUT_INACTIVE);
    ret |= gpio_pin_configure_dt(&reset_gpio, GPIO_OUTPUT_ACTIVE);
    ret |= gpio_pin_configure_dt(&busy_gpio, GPIO_INPUT);
    ret |= gpio_pin_configure_dt(&cs_gpio, GPIO_OUTPUT_INACTIVE);
    
    if (ret < 0) {
        LOG_ERR("Failed to configure GPIO: %d", ret);
        return ret;
    }
    
    LOG_INF("GPIO configured");
    
    /* Initialize Display */
    ret = jd79661_init();
    if (ret < 0) {
        LOG_ERR("Failed to init display");
        return ret;
    }
    
    /* Display default image on boot */
    LOG_INF("Loading default image (%u bytes)...", BUFFER_SIZE);
    memcpy(frame_buffer, image_image_boaviet, BUFFER_SIZE);
    jd79661_display_frame(frame_buffer, sizeof(frame_buffer));
    LOG_INF("Default image displayed. Waiting for BLE images...");

    while (1) {
        if (k_sem_take(&image_ready_sem, K_MSEC(500)) == 0) {
            LOG_INF("BLE image received (%u bytes), updating display...", pending_image_size);
            memcpy(frame_buffer, pending_image_data, pending_image_size);
            jd79661_display_frame(frame_buffer, sizeof(frame_buffer));
            ble_image_notify_display_done();
            LOG_INF("BLE image displayed successfully");
        }
        gpio_pin_toggle_dt(&led);
    }

    return 0;
}
```

## src/ble_backend.c
```c
#include <zephyr/kernel.h>
#include <zephyr/bluetooth/gatt.h>
#include <zephyr/bluetooth/hci.h>
#include <zephyr/logging/log.h>
#include <zephyr/settings/settings.h>

#include "ble_image_service.h"

LOG_MODULE_REGISTER(ble_backend);

static const struct bt_data ad[] = {
	BT_DATA_BYTES(BT_DATA_FLAGS, (BT_LE_AD_GENERAL | BT_LE_AD_NO_BREDR)),
	BT_DATA_BYTES(BT_DATA_UUID128_ALL, BLE_IMAGE_SERVICE_UUID),
};

static const struct bt_data sd[] = {
	BT_DATA(BT_DATA_NAME_COMPLETE, CONFIG_BT_DEVICE_NAME, sizeof(CONFIG_BT_DEVICE_NAME) - 1),
};

static void start_adv(void)
{
	int err;

	err = bt_le_adv_start(BT_LE_ADV_CONN_FAST_1, ad, ARRAY_SIZE(ad), sd, ARRAY_SIZE(sd));
	if (err) {
		LOG_ERR("Advertising failed to start (err %d)", err);
		return;
	}

	LOG_INF("Advertising successfully started");
}

static void connected(struct bt_conn *conn, uint8_t err)
{
	if (err) {
		LOG_ERR("Connection failed, err 0x%02x %s", err, bt_hci_err_to_str(err));
	} else {
		LOG_INF("Connected");
	}
}

static void disconnected(struct bt_conn *conn, uint8_t reason)
{
	LOG_INF("Disconnected, reason 0x%02x %s", reason, bt_hci_err_to_str(reason));
	start_adv();
}

BT_CONN_CB_DEFINE(conn_callbacks) = {
	.connected = connected,
	.disconnected = disconnected,
};

static void auth_cancel(struct bt_conn *conn)
{
	char addr[BT_ADDR_LE_STR_LEN];

	bt_addr_le_to_str(bt_conn_get_dst(conn), addr, sizeof(addr));

	LOG_INF("Pairing cancelled: %s", addr);
}

static struct bt_conn_auth_cb auth_cb_display = {
	.cancel = auth_cancel,
};

void backend_ble_hook(bool status, void *ctx)
{
	ARG_UNUSED(ctx);

	if (status) {
		LOG_INF("Bluetooth Logger Backend enabled.");
	} else {
		LOG_INF("Bluetooth Logger Backend disabled.");
	}
}

void ble_backend_init(void)
{
	int err;

	LOG_INF("Bluetooth LOG Demo");
	// logger_backend_ble_set_hook(backend_ble_hook, NULL);
	err = bt_enable(NULL);
	if (err) {
		LOG_ERR("Bluetooth init failed (err %d)", err);
		return;
	}
	
	settings_load();
	
	bt_conn_auth_cb_register(&auth_cb_display);

	start_adv();
}
```

## src/ble_image_service.c
```c
#include <zephyr/kernel.h>
#include <zephyr/bluetooth/bluetooth.h>
#include <zephyr/bluetooth/gatt.h>
#include <zephyr/bluetooth/uuid.h>
#include <zephyr/logging/log.h>
#include <string.h>

#include "ble_image_service.h"

LOG_MODULE_REGISTER(ble_image_svc, CONFIG_LOG_DEFAULT_LEVEL);

static uint8_t image_buffer[EPD_IMAGE_SIZE];
static uint16_t image_offset;
static uint16_t image_expected_size;
static bool transfer_active;
static ble_image_ready_cb_t ready_callback;

static struct bt_uuid_128 image_svc_uuid = BT_UUID_INIT_128(BLE_IMAGE_SERVICE_UUID);
static struct bt_uuid_128 image_data_uuid = BT_UUID_INIT_128(BLE_IMAGE_DATA_CHAR_UUID);
static struct bt_uuid_128 image_ctrl_uuid = BT_UUID_INIT_128(BLE_IMAGE_CTRL_CHAR_UUID);

static void ctrl_ccc_changed(const struct bt_gatt_attr *attr, uint16_t value);
static ssize_t data_write_cb(struct bt_conn *conn, const struct bt_gatt_attr *attr,
                             const void *buf, uint16_t len, uint16_t offset, uint8_t flags);
static ssize_t ctrl_write_cb(struct bt_conn *conn, const struct bt_gatt_attr *attr,
                             const void *buf, uint16_t len, uint16_t offset, uint8_t flags);

BT_GATT_SERVICE_DEFINE(image_svc,
    BT_GATT_PRIMARY_SERVICE(&image_svc_uuid),

    /* Image Data characteristic - Write Without Response */
    BT_GATT_CHARACTERISTIC(&image_data_uuid.uuid,
                           BT_GATT_CHRC_WRITE_WITHOUT_RESP,
                           BT_GATT_PERM_WRITE,
                           NULL, data_write_cb, NULL),

    /* Control characteristic - Write + Notify */
    BT_GATT_CHARACTERISTIC(&image_ctrl_uuid.uuid,
                           BT_GATT_CHRC_WRITE | BT_GATT_CHRC_NOTIFY,
                           BT_GATT_PERM_WRITE,
                           NULL, ctrl_write_cb, NULL),
    BT_GATT_CCC(ctrl_ccc_changed, BT_GATT_PERM_READ | BT_GATT_PERM_WRITE),
);

static bool notifications_enabled;

static void ctrl_ccc_changed(const struct bt_gatt_attr *attr, uint16_t value)
{
    notifications_enabled = (value == BT_GATT_CCC_NOTIFY);
    LOG_INF("Image ctrl notifications %s", notifications_enabled ? "enabled" : "disabled");
}

static void send_notification(const uint8_t *data, uint16_t len)
{
    if (!notifications_enabled) {
        return;
    }

    /* Ctrl characteristic value attr is at index 4 (after svc, data chrc, data val, ctrl chrc) */
    const struct bt_gatt_attr *attr = &image_svc.attrs[4];

    bt_gatt_notify(NULL, attr, data, len);
}

static void send_status(uint8_t status)
{
    send_notification(&status, 1);
}

static void send_progress(uint16_t received)
{
    uint8_t buf[3] = {IMG_STATUS_PROGRESS, received & 0xFF, received >> 8};
    send_notification(buf, sizeof(buf));
}

static void send_error(uint8_t err_code)
{
    uint8_t buf[2] = {IMG_STATUS_ERROR, err_code};
    send_notification(buf, sizeof(buf));
}

static ssize_t data_write_cb(struct bt_conn *conn, const struct bt_gatt_attr *attr,
                             const void *buf, uint16_t len, uint16_t offset, uint8_t flags)
{
    if (!transfer_active) {
        LOG_WRN("Data received but no transfer active");
        send_error(IMG_ERR_NOT_STARTED);
        return len;
    }

    if (image_offset + len > image_expected_size) {
        LOG_ERR("Data overflow: offset=%u len=%u expected=%u", image_offset, len, image_expected_size);
        send_error(IMG_ERR_OVERFLOW);
        transfer_active = false;
        return len;
    }

    memcpy(&image_buffer[image_offset], buf, len);
    image_offset += len;

    /* Send progress every ~1KB */
    if ((image_offset % 1024) < len || image_offset == image_expected_size) {
        send_progress(image_offset);
    }

    return len;
}

static ssize_t ctrl_write_cb(struct bt_conn *conn, const struct bt_gatt_attr *attr,
                             const void *buf, uint16_t len, uint16_t offset, uint8_t flags)
{
    const uint8_t *cmd = buf;

    if (len < 1) {
        return BT_GATT_ERR(BT_ATT_ERR_INVALID_ATTRIBUTE_LEN);
    }

    switch (cmd[0]) {
    case IMG_CMD_START:
        if (len < 3) {
            return BT_GATT_ERR(BT_ATT_ERR_INVALID_ATTRIBUTE_LEN);
        }
        image_expected_size = cmd[1] | (cmd[2] << 8);
        if (image_expected_size > EPD_IMAGE_SIZE) {
            LOG_ERR("Invalid image size: %u (max %u)", image_expected_size, EPD_IMAGE_SIZE);
            send_error(IMG_ERR_INVALID_SIZE);
            return len;
        }
        image_offset = 0;
        transfer_active = true;
        memset(image_buffer, 0, sizeof(image_buffer));
        LOG_INF("Image transfer started, expecting %u bytes", image_expected_size);
        send_status(IMG_STATUS_READY);
        break;

    case IMG_CMD_COMMIT:
        if (!transfer_active) {
            send_error(IMG_ERR_NOT_STARTED);
            return len;
        }
        if (image_offset < image_expected_size) {
            LOG_WRN("Incomplete transfer: %u/%u bytes", image_offset, image_expected_size);
            send_error(IMG_ERR_INCOMPLETE);
            return len;
        }
        transfer_active = false;
        LOG_INF("Image transfer complete (%u bytes), displaying...", image_offset);
        send_status(IMG_STATUS_DISPLAYING);

        if (ready_callback) {
            ready_callback(image_buffer, image_offset);
        }
        break;

    case IMG_CMD_CANCEL:
        transfer_active = false;
        image_offset = 0;
        LOG_INF("Image transfer cancelled");
        break;

    default:
        LOG_WRN("Unknown control command: 0x%02x", cmd[0]);
        return BT_GATT_ERR(BT_ATT_ERR_NOT_SUPPORTED);
    }

    return len;
}

void ble_image_service_init(ble_image_ready_cb_t callback)
{
    ready_callback = callback;
    transfer_active = false;
    image_offset = 0;
    LOG_INF("BLE Image Service initialized");
}

void ble_image_notify_display_done(void)
{
    send_status(IMG_STATUS_DONE);
    LOG_INF("Display done notification sent");
}
```

## src/ble_image_service.h
```c
#ifndef BLE_IMAGE_SERVICE_H
#define BLE_IMAGE_SERVICE_H

#include <zephyr/types.h>

#define EPD_IMAGE_SIZE 5776 /* 152*152/4 bytes, 2bpp */

/* BLE Image Service UUIDs */
#define BLE_IMAGE_SERVICE_UUID \
    BT_UUID_128_ENCODE(0x12345678, 0x1234, 0x5678, 0x1234, 0x56789abcdef0)

#define BLE_IMAGE_DATA_CHAR_UUID \
    BT_UUID_128_ENCODE(0x12345678, 0x1234, 0x5678, 0x1234, 0x56789abcdef1)

#define BLE_IMAGE_CTRL_CHAR_UUID \
    BT_UUID_128_ENCODE(0x12345678, 0x1234, 0x5678, 0x1234, 0x56789abcdef2)

/* Control commands (phone -> firmware) */
#define IMG_CMD_START  0x01 /* [0x01, size_lo, size_hi] */
#define IMG_CMD_COMMIT 0x02 /* [0x02] */
#define IMG_CMD_CANCEL 0x03 /* [0x03] */

/* Status notifications (firmware -> phone) */
#define IMG_STATUS_READY       0x00 /* Ready for data */
#define IMG_STATUS_PROGRESS    0x01 /* [0x01, received_lo, received_hi] */
#define IMG_STATUS_DISPLAYING  0x10 /* Started display refresh */
#define IMG_STATUS_DONE        0x11 /* Display refresh complete */
#define IMG_STATUS_ERROR       0xFF /* [0xFF, error_code] */

#define IMG_ERR_INVALID_SIZE   0x01
#define IMG_ERR_OVERFLOW       0x02
#define IMG_ERR_NOT_STARTED    0x03
#define IMG_ERR_INCOMPLETE     0x04

typedef void (*ble_image_ready_cb_t)(const uint8_t *data, uint16_t size);

void ble_image_service_init(ble_image_ready_cb_t callback);
void ble_image_notify_display_done(void);

#endif /* BLE_IMAGE_SERVICE_H */
```
